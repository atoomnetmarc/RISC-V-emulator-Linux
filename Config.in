## configs/rv32i_mmu_defconfig
```kconfig
BR2_riscv=y
BR2_riscv_custom=y
BR2_RISCV_ISA_RVI=y
BR2_RISCV_ISA_RVM=y
BR2_RISCV_ISA_RVA=y
# BR2_RISCV_ISA_RVF is not set
# BR2_RISCV_ISA_RVD is not set
# BR2_RISCV_ISA_RVC is not set
BR2_RISCV_32=y
BR2_RISCV_USE_MMU=y
BR2_RISCV_ABI_ILP32=y
BR2_TOOLCHAIN_BUILDROOT_GLIBC=y
BR2_TOOLCHAIN_BUILDROOT_VENDOR="buildroot"
BR2_SOFT_FLOAT=y
BR2_CCACHE=y
BR2_CCACHE_DIR="$(HOME)/.buildroot-ccache"
BR2_CCACHE_USE_BASEDIR=y
BR2_KERNEL_HEADERS_AS_KERNEL=y
BR2_PACKAGE_HOST_LINUX_HEADERS_CUSTOM_7_1=y
BR2_ROOTFS_OVERLAY="$(BR2_EXTERNAL_RV32I_PATH)/configs/rootfsoverlay"
BR2_ROOTFS_POST_BUILD_SCRIPT="$(BR2_EXTERNAL_RV32I_PATH)/configs/post-build.sh"
BR2_GLOBAL_PATCH_DIR="$(BR2_EXTERNAL_RV32I_PATH)/configs/patches"
BR2_TARGET_GENERIC_HOSTNAME="rv32i-linux-mmu"
BR2_TARGET_GENERIC_ISSUE="Welcome to rv32i-linux-mmu"
BR2_SYSTEM_DHCP=""
BR2_LINUX_KERNEL=y
BR2_LINUX_KERNEL_CUSTOM_VERSION=y
BR2_LINUX_KERNEL_CUSTOM_VERSION_VALUE="7.3.5"
BR2_LINUX_KERNEL_USE_CUSTOM_CONFIG=y
BR2_LINUX_KERNEL_CUSTOM_CONFIG_FILE="$(BR2_EXTERNAL_RV32I_PATH)/configs/kernel_config_mmu"
BR2_LINUX_KERNEL_IMAGE=y
BR2_LINUX_KERNEL_GZIP=y
BR2_PACKAGE_BUSYBOX=y
BR2_PACKAGE_BUSYBOX_CONFIG="$(BR2_EXTERNAL_RV32I_PATH)/configs/busybox_config"
BR2_PACKAGE_SL=y
BR2_PACKAGE_ASCII_INVADERS=y
BR2_PACKAGE_BVI=y
BR2_PACKAGE_BC=y
BR2_PACKAGE_MAWK=y
BR2_PACKAGE_NCURSES_TARGET_PROGS=y
BR2_PACKAGE_NANO=y
# BR2_PACKAGE_NANO_TINY is not set
BR2_PACKAGE_MC=y
BR2_PACKAGE_LINKS=y
BR2_PACKAGE_PYTHON3=y
BR2_PACKAGE_PYTHON3_READLINE=y
BR2_PACKAGE_PYTHON3_CURSES=y
BR2_PACKAGE_PYTHON3_ZLIB=y
BR2_PACKAGE_PYTHON3_SSL=y
BR2_PACKAGE_PYTHON3_SQLITE=y
BR2_PACKAGE_CA_CERTIFICATES=y
BR2_PACKAGE_LIBXCRYPT=y
BR2_TARGET_ROOTFS_EXT2=y
BR2_TARGET_ROOTFS_EXT2_4=y
BR2_TARGET_ROOTFS_EXT2_SIZE="1G"
BR2_TARGET_ROOTFS_EXT2_LABEL="rootfs"
BR2_PACKAGE_HOST_GENIMAGE=y
```
